## bootable/bootloader/uboot-amlogic/t962x3h/bl33/board/amlogic/defconfigs/hazel_defconfig
```kconfig
CONFIG_ARM=y
CONFIG_TARGET_MESON_TM2=y
CONFIG_HAZEL=y
CONFIG_DM=y
CONFIG_DM_GPIO=y
CONFIG_AML_GPIO=y
CONFIG_MTK_BT_USB=y
CONFIG_TEE=y
CONFIG_OPTEE=y
```

## bootable/bootloader/uboot-amlogic/t962x3h/bl33/board/amlogic/primrose/Kconfig
```kconfig
if TARGET_MESON_TM2

config SYS_CPU
	string
	default "armv8"

config SYS_BOARD
	string
	default "primrose"

config SYS_VENDOR
	string
	default "amlogic"

config SYS_SOC
	string
	default "tm2"

config SYS_CONFIG_NAME
	default "primrose"

config MTK_BT_USB
    bool "enable mtk bt usb function"
    default n
    help
        select this item will enable mtk bt usb device

endif
```

## kernel/amlogic/t962x3h/4.9/drivers/amlogic/boardinfo/Kconfig
```kconfig
#
# board info configuration
#

menuconfig AMLOGIC_VENDOR_BOARD_INFO
	tristate "Print Board Info"
	default n
	help
	  Say Y here to get to see options for board info.
	  This option alone does not add any kernel code.
	  If you say N, all options in this submenu will be
	  skipped and disabled.
```

## kernel/amlogic/t962x3h/4.9/drivers/perf/amlogic/Kconfig
```kconfig
# SPDX-License-Identifier: GPL-2.0-only
config AML_DDR_PMU
	depends on PERF_EVENTS && (ARM || ARM64)
	bool "AMLOGIC DDR PMU"
	default y
	help
	  Say y if you want to use amlogic DDR pmu.
```
